## conf/machine/hikey.conf
```bitbake
#@TYPE: Machine
#@NAME: LeMaker HiKey machine
#@DESCRIPTION: LeMaker HiKey machine

require conf/machine/include/arm/arch-armv8.inc

PREFERRED_PROVIDER_virtual/xserver ?= "xserver-xorg"

PREFERRED_PROVIDER_virtual/egl ?= "mesa-lima"
PREFERRED_PROVIDER_virtual/libgl ?= "mesa-lima"
PREFERRED_PROVIDER_virtual/libgles1 ?= "mesa-lima"
PREFERRED_PROVIDER_virtual/libgles2 ?= "mesa-lima"
PREFERRED_PROVIDER_virtual/mesa = "mesa-lima"


XSERVER ?= "xserver-xorg \
            mesa-driver-swrast \
            xf86-input-evdev \
            xf86-video-fbdev \
           "

MACHINE_FEATURES = "usbhost usbgadget alsa screen wifi bluetooth ext2 efi optee"

PREFERRED_PROVIDER_virtual/kernel ?= "linux-hikey-lima"

KERNEL_IMAGETYPE = "Image"
KERNEL_DEVICETREE = "hisilicon/hi6220-hikey.dtb"

CONSOLE_LINUX = "ttyAMA3"
CONSOLE_AOSP = "ttyFIQ0"
CONSOLE ?= "${CONSOLE_LINUX}"
SERIAL_CONSOLES = "115200;${CONSOLE}"

MACHINE_ESSENTIAL_EXTRA_RDEPENDS += "\
    edk2-hikey \
    grub-efi \
"

MACHINE_ESSENTIAL_EXTRA_RRECOMMENDS += "linux-firmware-wl12xx \
                                        linux-firmware-wl18xx \
                                        kernel-module-btwilink \
                                        kernel-module-st-drv \
                                        kernel-module-wl18xx \
                                        kernel-module-wlcore \
                                        kernel-module-wlcore-sdio \
                                        kernel-module-ti-conf-wl18xx \
                                       "

CMDLINE_ROOT_EMMC   = "mmcblk0p9"
CMDLINE_ROOT_SDCARD = "mmcblk1p2"
CMDLINE ?= "console=${CONSOLE},115200n8 root=/dev/${CMDLINE_ROOT_EMMC} rootwait rw quiet efi=noruntime"

# Fastboot expects an ext4 image, which needs to be 4096 bytes aligned
IMAGE_FSTYPES_append = " ext4.gz"
IMAGE_ROOTFS_ALIGNMENT = "4096"
EXTRA_IMAGECMD_ext4 += " -L rootfs "

EXTRA_IMAGEDEPENDS = "edk2-hikey grub-efi burn-boot"

# Ensure we have enough free space to deploy tests
IMAGE_ROOTFS_EXTRA_SPACE = "1048576"
```
